;  Generated by PSoC Designer 5.4.3191
;
;
;  PSoCGPIOINT.inc
;
;  Data: 29 October, 2001
;  Copyright (c) Cypress Semiconductor 2015. All Rights Reserved.
;
;  This file is generated by the Device Editor on Application Generation.
;  It contains equates that are useful in writing code relating to GPIO
;  related interrupts.
;  
;  DO NOT EDIT THIS FILE MANUALLY, AS IT IS OVERWRITTEN!!!
;  Edits to this file will not be preserved.
;
; Port_0_4 address and mask equates
Port_0_4_Data_ADDR:	equ	0h
Port_0_4_DriveMode_0_ADDR:	equ	100h
Port_0_4_DriveMode_1_ADDR:	equ	101h
Port_0_4_DriveMode_2_ADDR:	equ	3h
Port_0_4_GlobalSelect_ADDR:	equ	2h
Port_0_4_IntCtrl_0_ADDR:	equ	102h
Port_0_4_IntCtrl_1_ADDR:	equ	103h
Port_0_4_IntEn_ADDR:	equ	1h
Port_0_4_MASK:	equ	10h
